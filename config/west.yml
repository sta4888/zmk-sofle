## config/west.yml
```yaml
manifest:
  remotes:
    - name: zmkfirmware
      url-base: https://github.com/zmkfirmware
    - name: oleksandrmaslov
      url-base: https://github.com/oleksandrmaslov
    - name: a741725193
      url-base: https://github.com/a741725193
  projects:
    - name: zmk-pointing-acceleration
      remote: oleksandrmaslov
      revision: main
      path: modules/lib/zmk-pointing-acceleration
    - name: eyelash_sofle
      remote: a741725193
      revision: main
    - name: zmk
      remote: zmkfirmware
      revision: v0.3.0
      import: app/west.yml
  self:
    path: boards
```
